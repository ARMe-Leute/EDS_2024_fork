/**
 ******************************************************************************
 * @file	ST7735.c
 * @author 	Henning Karlsen (C)2010-2013
 * @author 	V1.1 Lea Hoß and Samuel Schieber (Students of DHBW Stuttgart)
 * 			Redesign and further development
 * @author	V1.2 Prof Flaemig <https://github.com/tflaemig68/>
 * @brief	ST7735 TFT Graphic Interface V1.2
 * @brief 	sorry, until now, there no doxygen compatible comments included
 * @date	V1.2 Aug. 2025
 ******************************************************************************
 * @attention This software is licensed based on CC BY-NC-SA 4.0
 * @attention Code has been ported from Arduino Adafruit library.
 * @attention Copyrigths below:
 *  This is a library for the Adafruit 1.8" SPI display.
 *  This library works with the Adafruit 1.8" TFT Breakout w/SD card
 *  ----> http://www.adafruit.com/products/358
 *  as well as Adafruit raw 1.8" TFT display
 *  ----> http://www.adafruit.com/products/618
 *
 * Written by Limor Fried/Ladyada for Adafruit Industries.
 * MIT license, all text above must be included in any redistribution
 *
 * Some parts of code have been ported from Arduino Adafruit & UTFT libraries.
 * Copyrights below:
 * Written by Limor Fried/Ladyada for Adafruit Industries.
 * MIT license, all text above must be included in any redistribution
 * UTFT.cpp - Arduino/chipKit library support for Color TFT tft Boards
 * Copyright (C)2010-2013 Henning Karlsen. All right reserved
 * This library is free software; you can redistribute it and/or
 * modify it under the terms of the CC BY-NC-SA 3.0 license.
 * Please see the included documents for further information.
 *********************************************************************************
 */



#include <graphics.h>
#include <math.h>
#include <string.h>
#include <stdlib.h>
#include <stdio.h>
#include <ST7735.h>
#include <mcalSysTick.h>
#include <mcalGPIO.h>
#include <mcalSPI.h>

static uint16_t width = ST7735_TFTWIDTH;
static uint16_t height = ST7735_TFTHEIGHT;

/*****************************************************************************************
Hardware Configuration
******************************************************************************************/

/****************************************************************************************
*
* Hardware configuration and low level functions
*
* The idea of HW initialization and configuration have taken on from
* http://vg.ucoz.ru/load/stm32_ickhodnye_teksty_programm_na_si/stm32_biblioteka_podkljuchenija_displeja_na_kontrollere_st7735_dlja_stm32f4/16-1-0-41
****************************************************************************************/



static SPI_TypeDef  *spi  = SPI1;


/* Function creates delay
 * delayValue is in ms
 */
void delayms(uint32_t delayValue)
{
	systickDelay(&ST7735_Timer, delayValue);
}


// Function sends byte via SPI to controller
void tftSPISenddata(const uint8_t data)
{
	spiWriteByte(spi, ST7735_CS_PORT, ST7735_CS, data);
}


// Function sends byte via SPI to controller
void tftSPISenddata16(const uint16_t data)
{
	spiWriteWord(spi, ST7735_CS_PORT, ST7735_CS, data);
}


// Function sends control command to controller
void tftSendCmd(const uint8_t cmd)
{
	ST7735_DC0;
    tftSPISenddata(cmd);
}


// Function that sends parameters or a command to controller
void tftSendData(const uint8_t data)
{
    ST7735_DC1;
    tftSPISenddata(data);
}

// Function that initializes the hardware configuration
void spiInit(void)
{

    // Declaration of SPI & IO Pins for ST7735-Port
    gpioSelectPort(ST7735_RST_PORT);
    gpioSelectPinMode(ST7735_RST_PORT, ST7735_RST, OUTPUT);		// RESET
    gpioSelectPort(ST7735_DC_PORT);
    gpioSelectPinMode(ST7735_DC_PORT, ST7735_DC, OUTPUT);		// DATA/Command

    gpioInitPort(ST7735_CS_PORT);
    gpioSelectPinMode(ST7735_CS_PORT,ST7735_CS, OUTPUT);        // CS
    gpioSelectPushPullMode(ST7735_CS_PORT, ST7735_CS, PULLUP);

    gpioInitPort(ST7735_SPI_PORT);
    gpioSelectPinMode(ST7735_SPI_PORT, ST7735_CLK, ALTFUNC);	// SPI1 Clock
    gpioSelectAltFunc(ST7735_SPI_PORT, ST7735_CLK, AF5);
    gpioSelectPinMode(ST7735_SPI_PORT, ST7735_MOSI, ALTFUNC);	// SPI1 MOSI
    gpioSelectAltFunc(ST7735_SPI_PORT, ST7735_MOSI, AF5);

    // initialization of  SPI1
    spiSelectSPI(spi);
    spiInitSPI(spi, CLK_DIV_16, SPI_DATA_8_BIT, SSM_ON, SSI_LVL_HIGH, MASTER, SPI_PHASE_EDGE_1, SPI_IDLE_LOW);

}

/*****************************************************************************************
Hardware Configuration end
******************************************************************************************/

/*****************************************************************************************
Fonts
******************************************************************************************/
/*
  UTFT.cpp - Arduino/chipKit library support for Color TFT LCD Boards
  Copyright (C)2010-2013 Henning Karlsen. All right reserved

  This library is the continuation of my ITDB02_Graph, ITDB02_Graph16
  and RGB_GLCD libraries for Arduino and chipKit. As the number of
  supported display modules and controllers started to increase I felt
  it was time to make a single, universal library as it will be much
  easier to maintain in the future.

  Basic functionality of this library was origianlly based on the
  demo-code provided by ITead studio (for the ITDB02 modules) and
  NKC Electronics (for the RGB GLCD module/shield).

  This library supports a number of 8bit, 16bit and serial graphic
  displays, and will work with both Arduino and chipKit boards. For a
  full list of tested display modules and controllers, see the
  document UTFT_Supported_display_modules_&_controllers.pdf.

  When using 8bit and 16bit display modules there are some
  requirements you must adhere to. These requirements can be found
  in the document UTFT_Requirements.pdf.
  There are no special requirements when using serial displays.

  You can always find the latest version of the library at
  http://electronics.henningkarlsen.com/

  If you make any modifications or improvements to the code, I would
  appreciate that you share the code with me so that I might include
  it in the next release. I can be contacted through
  http://electronics.henningkarlsen.com/contact.php.

  This library is free software; you can redistribute it and/or
  modify it under the terms of the CC BY-NC-SA 3.0 license.
  Please see the included documents for further information.
*/

// SmallFont.c
// Font Size	: 8x12
// Memory usage	: 1144 bytes
// # characters	: 95

const unsigned char SmallFont[] = {
0x08,0x0C,0x20,0x5F,
0x00,0x00,0x00,0x00,0x00,0x00,0x00,0x00,0x00,0x00,0x00,0x00, // <Space>
0x00,0x00,0x20,0x20,0x20,0x20,0x20,0x20,0x00,0x20,0x00,0x00, // !
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0x40,0xA4,0x18,0x00,0x00,0x00,0x00,0x00,0x00,0x00,0x00,0x00, // ~
};


// BigFont.c (C)2010 by Henning Karlsen
// Font Size	: 16x16
// Memory usage	: 3044 bytes
// # characters	: 95

const unsigned char BigFont[] = {
0x10,0x10,0x20,0x5F,
0x00,0x00,0x00,0x00,0x00,0x00,0x00,0x00,0x00,0x00,0x00,0x00,0x00,0x00,0x00,0x00,0x00,0x00,0x00,0x00,0x00,0x00,0x00,0x00,0x00,0x00,0x00,0x00,0x00,0x00,0x00,0x00, //  <Space>
0x00,0x00,0x00,0x00,0x07,0x00,0x0F,0x80,0x0F,0x80,0x0F,0x80,0x0F,0x80,0x0F,0x80,0x07,0x00,0x07,0x00,0x00,0x00,0x00,0x00,0x07,0x00,0x07,0x00,0x07,0x00,0x00,0x00, // !
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0x00,0x00,0x00,0x00,0x1F,0x1C,0x3B,0x9C,0x39,0xDC,0x38,0xF8,0x00,0x00,0x00,0x00,0x00,0x00,0x00,0x00,0x00,0x00,0x00,0x00,0x00,0x00,0x00,0x00,0x00,0x00,0x00,0x00  // ~
};

// SevenSegNumFont.c
// Font Size	: 32x50
// Memory usage	: 2004 bytes
// # characters	: 10

const unsigned char SevenSegNumFont[] ={
0x20,0x32,0x30,0x0A,
0x00,0x00,0x00,0x00,0x00,0x00,0x00,0x00,0x00,0xFF,0xFE,0x00,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0x00,  // 0
0x00,0x00,0x00,0x00,0x00,0x00,0x00,0x00,0x00,0x00,0x00,0x00,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0x00,  // 1
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0x00,0x00,0x00,0x00,0x00,0x00,0x00,0x00,0x00,0xFF,0xFE,0x00,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0x00,  // 9
};

/*****************************************************************************************
Fonts end
******************************************************************************************/


// Rather than a bazillion tft7735_sendCmd() and tft7735_sendData() calls, screen
// initialization commands and arguments are organized in these tables
// stored in PROGMEM.  The table may look bulky, but that's mostly the
// formatting -- storage-wise this is hundreds of bytes more compact
// than the equivalent code.  Companion function follows.
#define DELAY 0x80

// Init for 7735R, part 1 (red or green tab)
static const uint8_t  Rcmd1[] = {
	15,							// 15 commands in list:
	ST7735_SWRESET,   DELAY,	//  1: Software reset, 0 args, w/delay
	150,						//     150 ms delay
	ST7735_SLPOUT ,   DELAY,	//  2: Out of sleep mode, 0 args, w/delay
	255,						//     500 ms delay
	ST7735_FRMCTR1, 3      ,	//  3: Frame rate ctrl - normal mode, 3 args:
	0x01, 0x2C, 0x2D,			//     Rate = fosc/(1x2+40) * (LINE+2C+2D)
	ST7735_FRMCTR2, 3      ,	//  4: Frame rate control - idle mode, 3 args:
	0x01, 0x2C, 0x2D,			//     Rate = fosc/(1x2+40) * (LINE+2C+2D)
	ST7735_FRMCTR3, 6      ,	//  5: Frame rate ctrl - partial mode, 6 args:
	0x01, 0x2C, 0x2D,			//     Dot inversion mode
	0x01, 0x2C, 0x2D,			//     Line inversion mode
	ST7735_INVCTR , 1      ,	//  6: Display inversion ctrl, 1 arg, no delay:
	0x07,						//     No inversion
	ST7735_PWCTR1 , 3      ,	//  7: Power control, 3 args, no delay:
	0xA2,
	0x02,						//     -4.6V
	0x84,						//     AUTO mode
	ST7735_PWCTR2 , 1      ,	//  8: Power control, 1 arg, no delay:
	0xC5,						//     VGH25 = 2.4C VGSEL = -10 VGH = 3 * AVDD
	ST7735_PWCTR3 , 2      ,	//  9: Power control, 2 args, no delay:
	0x0A,						//     Opamp current small
	0x00,						//     Boost frequency
	ST7735_PWCTR4 , 2      ,	// 10: Power control, 2 args, no delay:
	0x8A,						//     BCLK/2, Opamp current small & Medium low
	0x2A,
	ST7735_PWCTR5 , 2      ,	// 11: Power control, 2 args, no delay:
	0x8A, 0xEE,
	ST7735_VMCTR1 , 1      ,	// 12: Power control, 1 arg, no delay:
	0x0E,
	ST7735_INVOFF , 0      ,	// 13: Don't invert display, no args, no delay
	ST7735_MADCTL , 1      ,	// 14: Memory access control (directions), 1 arg:
	0xC0,						//     row addr/col addr, bottom to top refresh, RGB order
	ST7735_COLMOD , 1+DELAY,	//  15: Set color mode, 1 arg + delay:
	0x05,						//     16-bit color 5-6-5 color format
	10							//     10 ms delay
};

// Init for 7735R, part 2 (green tab only)
static const uint8_t Rcmd2green[] = {
	2,							//  2 commands in list:
	ST7735_CASET  , 4      ,	//  1: Column addr set, 4 args, no delay:
	0x00, 0x02,					//     XSTART = 0
	0x00, 0x7F+0x02,			//     XEND = 129
	ST7735_RASET  , 4      ,	//  2: Row addr set, 4 args, no delay:
	0x00, 0x01,					//     XSTART = 0
	0x00, 0x9F+0x01				//     XEND = 160
};

// Init for 7735R, part 2 (red tab only)
static const uint8_t Rcmd2red[] = {
	2,							//  2 commands in list:
	ST7735_CASET  , 4      ,	//  1: Column addr set, 4 args, no delay:
	0x00, 0x00,					//     XSTART = 0
	0x00, 0x7F,					//     XEND = 127
	ST7735_RASET  , 4      ,	//  2: Row addr set, 4 args, no delay:
	0x00, 0x00,					//     XSTART = 0
	0x00, 0x9F				//     XEND = 159
};

// Init for 7735R, part 3 (red or green tab)
static const uint8_t Rcmd3[] = {
	4,							//  4 commands in list:
	ST7735_GMCTRP1, 16      ,	//  1: Magical unicorn dust, 16 args, no delay:
	0x02, 0x1c, 0x07, 0x12,
	0x37, 0x32, 0x29, 0x2d,
	0x29, 0x25, 0x2B, 0x39,
	0x00, 0x01, 0x03, 0x10,
	ST7735_GMCTRN1, 16      ,	//  2: Sparkles and rainbows, 16 args, no delay:
	0x03, 0x1d, 0x07, 0x06,
	0x2E, 0x2C, 0x29, 0x2D,
	0x2E, 0x2E, 0x37, 0x3F,
	0x00, 0x00, 0x02, 0x10,
	ST7735_NORON  ,    DELAY,	//  3: Normal display on, no args, w/delay
	10,							//     10 ms delay
	ST7735_DISPON ,    DELAY,	//  4: Main screen turn on, no args w/delay
	100							//     100 ms delay
};

#define putpix(c) { tftSPISenddata(c >> 8); tftSPISenddata(c & 0xFF); }
//define putpix(c) { tftSPISenddata16(c);} //doesnt work

//default values for start Position
static int colstart = 0; // May be overwritten in init func
static int rowstart = 0; // May be overwritten in init func

static uint8_t orientation = PORTRAIT;
typedef struct _font {
	uint8_t 	*font;
	uint8_t 	x_size;
	uint8_t 	y_size;
	uint8_t		offset;
	uint16_t	numchars;
} Font;

static Font cfont;
static uint8_t _transparent = 0;
static uint16_t _fg = tft_GREEN;
static uint16_t _bg = tft_BLACK;

/*Companion code to the above tables.  Reads and issues
* a series of tft commands stored in PROGMEM byte array.
*/
static void commandList(const uint8_t *addr)
{
	uint8_t  numCommands, numArgs;
	uint16_t ms;

	numCommands = *addr++;   // Number of commands to follow
	while(numCommands--) {                 // For each command...
		tftSendCmd(*addr++); //   Read, issue command
		numArgs  = *addr++;    //   Number of args to follow
		ms       = numArgs & DELAY;          //   If hibit set, delay follows args
		numArgs &= ~DELAY;                   //   Mask out delay bit
		while(numArgs--) {                   //   For each argument...
			tftSendData(*addr++);  //     Read, issue argument
		}

		if(ms) {
			ms = *addr++; // Read post-command delay time (ms)
			if(ms == 255) ms = 500;     // If 255, delay for 500 ms
			delayms(ms);
		}
	}
}

// Initialization code common to both 'B' and 'R' type displays
static void commonInit(const uint8_t *cmdList)
{
	// toggle RST low to reset; CS low so it'll listen to us
	ST7735_CS0;
#ifdef tft_SOFT_RESET
	tftSendCmd(ST7735_SWRESET);
	delayms(500);
#else
	//ST7735_RST1;
	//delay_ms(500);
	ST7735_RST0;
	delayms(50);  //default value 500
	ST7735_RST1;
	//delay_ms(500);
#endif
	if(cmdList) commandList(cmdList);
}

// Initialization for ST7735R screens (green or red tabs)
void tftInitR(uint8_t options)
{
	delayms(50);
	commonInit(Rcmd1);
	//chooses initialization for specific display type
	if(options == INITR_GREENTAB)
	{
		commandList(Rcmd2green);
		//Starting position of rows and columns
		colstart = 2;
		rowstart = 1;
	}
	else
	{
		// colstart, rowstart left at default '0' values
		commandList(Rcmd2red);
	}
	commandList(Rcmd3);

	// if black, change MADCTL color filter
	if (options == INITR_BLACKTAB)
	{
		tftSendCmd(ST7735_MADCTL);
		tftSendData(0xC0);
	}

	//  tabcolor = options;
}

/*sets Window for what will be printed on display
 * x0, x1 are start column and end column
 * y0, y1 are start row and end row
 */
void tftSetAddrWindow(uint8_t x0, uint8_t y0, uint8_t x1, uint8_t y1)
{
	tftSendCmd(ST7735_CASET);		// Column addr set
	tftSendData(0x00);
	tftSendData(x0+colstart);     // XSTART
	tftSendData(0x00);
	tftSendData(x1+colstart);     // XEND

	tftSendCmd(ST7735_RASET); // Row addr set
	tftSendData(0x00);
	tftSendData(y0+rowstart);     // YSTART
	tftSendData(0x00);
	tftSendData(y1+rowstart);     // YEND

	tftSendCmd(ST7735_RAMWR); // write to RAM
}

//colors selected pixel in chosen color
void tftPushColor(uint16_t color)
{
	ST7735_DC1;
	putpix(color);
}

/* draw single colored pixel on screen
 * x and y are the Position, color examples are defined in tft Display Header
 */
void tftDrawPixel(int16_t x, int16_t y, uint16_t color)
{
	if((x < 0) ||(x >= width) || (y < 0) || (y >= height))
		{
		return;
		}

	tftSetAddrWindow(x,y,x+1,y+1);
	tftPushColor(color);
}

/*fill a rectangle
 * x and y are starting position
 * w is width, h is height
 */
void tftFillRect(int16_t x, int16_t y, int16_t w, int16_t h, uint16_t color)
{
	// rudimentary clipping (drawChar w/big text requires this)
	if((x >= width) || (y >= height))
		{
		return;
		}

	if((x + w - 1) >= width)
		{
		w = width  - x;
		}

	if((y + h - 1) >= height)
		{
		h = height - y;
		}

	tftSetAddrWindow(x, y, x+w-1, y+h-1);

	ST7735_DC1;
	for(y=h; y>0; y--)
	{
		for(x=w; x>0; x--)
		{
			putpix(color);
		}
	}
}

/*
 * draws vertical line
 * x an y are starting point
 * h is height
 */
void tftDrawFastVLine(int16_t x, int16_t y, int16_t h, uint16_t color) {
	// Rudimentary clipping
	if((x >= width) || (y >= height)) return;
	if((y+h-1) >= height) h = height-y;
	tftSetAddrWindow(x, y, x, y+h-1);

	ST7735_DC1;
	while (h--) {
		putpix(color);
	}
}

/*
 * draws horizontal line
 * x an y are starting point
 * w is width
 */
void tftDrawFastHLine(int16_t x, int16_t y, int16_t w, uint16_t color)
{
	// Rudimentary clipping
	if((x >= width) || (y >= height))
		{
		return;
		}

	if((x+w-1) >= width)
		{
		w = width-x;
		}

	tftSetAddrWindow(x, y, x+w-1, y);

	ST7735_DC1;
	while (w--)
	{
		putpix(color);
	}
}

/*
 * draws line between two x-/y-coordinates
 * x1, y1 is starting point
 * x2, y2 is ending point
 */
void tftDrawFastLine(uint8_t x1, uint8_t y1, uint8_t x2, uint8_t y2, uint16_t color)
{
	signed char   dx, dy, sx, sy;
	unsigned char  x,  y, mdx, mdy, l;

	// horizontal or vertical line
	if (x1==x2) {
		tftFillRect(x1,y1, x1,y2, color); // vertical line
		return;
	}

	if (y1==y2) {
		tftFillRect(x1,y1, x2,y1, color); // horizontal line
		return;
	}

	// angled line
	dx=x2-x1;
	dy=y2-y1;

	//setting gradient depending on chosen coordinates
	if (dx>=0)
	{
		mdx=dx;
		sx=1;
	}
	else
	{
		mdx=x1-x2;
		sx=-1;
	}

	if (dy>=0)
	{
		mdy=dy;
		sy=1;
	}
	else
	{
		mdy=y1-y2;
		sy=-1;
	}

	x=x1;
	y=y1;

	if (mdx>=mdy)
	{
		l=mdx;
		while (l>0)
		{
			if (dy>0)
			{
				y=y1+mdy*(x-x1)/mdx; // straight line equation for positive gradient
			}
			else
			{
				y=y1-mdy*(x-x1)/mdx; // straight line equation for negative gradient
			}
			tftDrawPixel(x,y,color); //colors pixels of the line
			x=x+sx;
			l--;
		}
	} else
	{
		l=mdy;
		while (l>0)
		{
			if (dy>0)
			{
				x=x1+((mdx*(y-y1))/mdy); // straight line equation for positive gradient
			}
			else
			{
				x=x1+((mdx*(y1-y))/mdy); // straight line equation for negative gradient
			}
			tftDrawPixel(x,y,color); // colors pixels of the line
			y=y+sy;
			l--;
		}
	}
	tftDrawPixel(x2, y2, color);
}


/* Function that draws a rectangle
 * x1 is start parameter x
 * x2 is end parameter x
 * y1 is start parameter y
 * y2 is end parameter y
*/
void tftDrawRect(uint8_t x1,uint8_t y1,uint8_t x2,uint8_t y2, uint16_t color)
{
	tftDrawFastHLine(x1,y1,x2-x1, color);
	tftDrawFastVLine(x2,y1,y2-y1, color);
	tftDrawFastHLine(x1,y2,x2-x1, color);
	tftDrawFastVLine(x1,y1,y2-y1, color);
}


/* Function that draws a circle
 * x is x center coordinate
 * y is y center coordinate
 * radius is radius in pixel
*/
void tftDrawCircle(int16_t x, int16_t y, int radius, uint16_t color)
{
	int f = 1 - radius;
	int ddF_x = 1;
	int ddF_y = -2 * radius;
	int x1 = 0;
	int y1 = radius;

	tftSetAddrWindow(x, y + radius, x, y + radius);
	tftPushColor(color);
	tftSetAddrWindow(x, y - radius, x, y - radius);
	tftPushColor(color);
	tftSetAddrWindow(x + radius, y, x + radius, y);
	tftPushColor(color);
	tftSetAddrWindow(x - radius, y, x - radius, y);
	tftPushColor(color);

	while(x1 < y1)
	{
		if(f >= 0)
		{
			y1--;
			ddF_y += 2;
			f += ddF_y;
		}

		x1++;
		ddF_x += 2;
		f += ddF_x;


		tftSetAddrWindow(x + x1, y + y1, x + x1, y + y1);
		tftPushColor(color);
		tftSetAddrWindow(x - x1, y + y1, x - x1, y + y1);
		tftPushColor(color);
		tftSetAddrWindow(x + x1, y - y1, x + x1, y - y1);
		tftPushColor(color);
		tftSetAddrWindow(x - x1, y - y1, x - x1, y - y1);
		tftPushColor(color);
		tftSetAddrWindow(x + y1, y + x1, x + y1, y + x1);
		tftPushColor(color);
		tftSetAddrWindow(x - y1, y + x1, x - y1, y + x1);
		tftPushColor(color);
		tftSetAddrWindow(x + y1, y - x1, x + y1, y - x1);
		tftPushColor(color);
		tftSetAddrWindow(x - y1, y - x1, x - y1, y - x1);
		tftPushColor(color);
	}
}


/* Function that draws a filled Circle
 * x is x-center-coordinate
 * y is y-center-coordinate
*/
void tftFillCircle(int16_t x, int16_t y, int radius, uint16_t color)
{
	int x1,y1;

	for(y1=-radius; y1<=0; y1++)
	{
		for(x1=-radius; x1<=0; x1++)
		{
			if(x1*x1+y1*y1 <= radius*radius)
			{
				tftDrawFastHLine(x+x1, y+y1, 2*(-x1), color); //Draw a line from one side of the circular arc to the other side.
				tftDrawFastHLine(x+x1, y-y1, 2*(-x1), color);
				break;
			}
		}
	}
}


/* Function that prints a Bitmap-Graphic
 * x is x-position of pictures top left corner
 * y is y-position of pictures top left corner
 * sx is the width of the picture in pixels
 * ys is the height of the picture in pixels
 * data contains the bitmap-graphic
 * scale: e.g. 2 means twice the original size
*/
void tftDrawBitmap(int x, int y, int sx, int sy, bitmapdatatype data, int scale)
{
	int tx, ty, tc, tsx, tsy;

	if (scale==1)
	{
		if (orientation == PORTRAIT || orientation == PORTRAIT_FLIP)
		{
			tftSetAddrWindow(x, y, x+sx-1, y+sy-1);
			ST7735_DC1;

			for (tc=0; tc<(sx*sy); tc++)
			{
				putpix(data[tc]);
			}
		}
		else
		{
			for (ty=0; ty<sy; ty++)
			{
				tftSetAddrWindow(x, y+ty, x+sx-1, y+ty);
				ST7735_DC1;
				for (tx=sx-1; tx>=0; tx--)
				{
					putpix(data[(ty*sx)+tx]);
				}
			}
		}
	}
	else
	{
		if (orientation == PORTRAIT || orientation == PORTRAIT_FLIP)
		{
			for (ty=0; ty<sy; ty++)
			{
				tftSetAddrWindow(x, y+(ty*scale), x+((sx*scale)-1), y+(ty*scale)+scale);
				for (tsy=0; tsy<scale; tsy++)
				{
					for (tx=0; tx<sx; tx++)
					{
						for (tsx=0; tsx<scale; tsx++)
						{
							tftPushColor(data[(ty*sx)+tx]);
						}
					}
				}
			}
		}
		else
		{
			for (ty=0; ty<sy; ty++)
			{
				for (tsy=0; tsy<scale; tsy++)
				{
					tftSetAddrWindow(x, y+(ty*scale)+tsy, x+((sx*scale)-1), y+(ty*scale)+tsy);
					for (tx=sx-1; tx>=0; tx--)
					{
						for (tsx=0; tsx<scale; tsx++)
						{
							tftPushColor(data[(ty*sx)+tx]);
						}
					}
				}
			}
		}
	}
}


/* Function that prints a Rotatet-Bitmap-Graphic
 * x is x-position of pictures top left corner
 * y is y-position of pictures top left corner
 * sx is the width of the picture in pixels
 * ys is the height of the picture in pixels
 * data contains the bitmap-graphic
 * deg is the angle of rotation
 * rox is x-position of rotation origin
 * roy is y-position of rotation origin
*/
void tftDrawBitmapRotate(int x, int y, int sx, int sy, bitmapdatatype data, int deg, int rox, int roy)
{
	int tx, ty, newx, newy;
	double radian;
	radian=deg*0.0175;

	if (deg==0)
	{
		tftDrawBitmap(x, y, sx, sy, data, 1);
	}
	else
	{
		for (ty=0; ty<sy; ty++)
		{
			for (tx=0; tx<sx; tx++)
			{
				newx=x+rox+(((tx-rox)*cos(radian))-((ty-roy)*sin(radian)));
				newy=y+roy+(((ty-roy)*cos(radian))+((tx-rox)*sin(radian)));

				tftSetAddrWindow(newx, newy, newx, newy);
				tftPushColor(data[(ty*sx)+tx]);
			}
		}
	}

}


/* Function that sets the font
 * fonts are listed in DefaultFonts.h
*/
void tftSetFont(uint8_t* font)
{
	cfont.font=font;
	cfont.x_size=font[0];
	cfont.y_size=font[1];
	cfont.offset=font[2];
	cfont.numchars=font[3];
}


/* Function that prints a char
 * charval is ASCII-Value of char to print
 * x is x position of character
 * y is y position of character
*/
void tftSetColor(uint16_t FontColor, uint16_t BackColor)
{
	_fg = FontColor;
	_bg = BackColor;
}

void tftPrintChar(uint8_t charval, int x, int y)
{
	uint8_t i,ch,fz;
	uint16_t j;
	uint16_t temp;
	int zz;

	if(cfont.x_size < 8)
	{
		fz = cfont.x_size;
	}
	else
	{
		fz = cfont.x_size/8;
	}
	if (!_transparent)
	{
		tftSetAddrWindow(x,y,x+cfont.x_size-1,y+cfont.y_size-1);
		temp=((charval-cfont.offset)*((fz)*cfont.y_size))+4;

		for(j=0;j<((fz)*cfont.y_size);j++)
		{
			ch = cfont.font[temp];

			for(i=0;i<8;i++)
			{
				if((ch&(1<<(7-i)))!=0)
				{
					tftPushColor(_fg);
				}
				else
				{
					tftPushColor(_bg);
				}
			}
			temp++;
		}
	}
	else
	{
		temp=((charval-cfont.offset)*((fz)*cfont.y_size))+4;
		for(j=0;j<cfont.y_size;j++)
		{
			for (zz=0; zz<(fz); zz++)
			{
				ch = cfont.font[temp+zz];
				for(i=0;i<8;i++)
				{
					tftSetAddrWindow(x+i+(zz*8),y+j,x+i+(zz*8)+1,y+j+1);

					if((ch&(1<<(7-i)))!=0)
					{
						tftPushColor(_fg);
					}
				}
			}
			temp+=(fz);
		}
	}
}


/* Function that prints a rotated char
 * charval is ASII-Value of char to print
 * x is x position
 * y is y position of character
 * pos is the position of that character in a text (number of preceding characters)
 * deg is the rotation angle in degree
*/
void tftRotateChar(uint8_t charval, int x, int y, int pos, int deg)
{
	uint8_t i,j,ch,fz;
	uint16_t temp;
	int newx,newy;
	double radian = deg*0.0175;
	int zz;

	if(cfont.x_size < 8)
	{
		fz = cfont.x_size;
	}
	else
	{
	fz = cfont.x_size/8;
	temp=((charval-cfont.offset)*((fz)*cfont.y_size))+4;
	}
	for(j=0; j<cfont.y_size; j++)
	{
		for (zz=0;zz<(fz);zz++)
		{
			ch = cfont.font[temp+zz];

			for(i=0;i<8;i++)
			{
				newx=x+(((i+(zz*8)+(pos*cfont.x_size))*cos(radian))-((j)*sin(radian)));
				newy=y+(((j)*cos(radian))+((i+(zz*8)+(pos*cfont.x_size))*sin(radian)));

				tftSetAddrWindow(newx,newy,newx+1,newy+1);

				if((ch&(1<<(7-i)))!=0)
				{
					tftPushColor(_fg);
				}
				else
				{
					if (!_transparent)
					{
						tftPushColor(_bg);
					}
				}
			}
		}
		temp+=(fz);
	}
}


/* output of integer value on display
 * value is integer to print
 * x is x-coordinate in pixels
 * y is y-coordinate in pixels
 * deg is angle of rotation in degree
*/
void tftPrintInt(int value,int x, int y, int deg)
{
	char buffer[100];
	sprintf(buffer,"%d",value);
	tftPrint(buffer,x,y,deg);
}


/* output of long value on display
 * value is long to print
 * x is x-coordinate in pixels
 * y is y-coordinate in pixels
 * deg is angle of rotation in degree
*/
void tftPrintLong(long value,int x, int y, int deg)
{
	char buffer[100];
	sprintf(buffer,"%ld",value);
	tftPrint(buffer,x,y,deg);
}


/* output of float value on display
 * value is float to print
 * x is x-coordinate in pixels
 * y is y-coordinate in pixels
 * deg is angle of rotation in degree
*/
void tftPrintFloat(float value,int x, int y, int deg)
{
	char buffer[100];
	sprintf(buffer,"%lf",value);
	tftPrint(buffer,x,y,deg);
}


/* output of double value on display
 * value is double to print !!!attention not more than 6 digit after decimal point possible!!!
 * x is x-coordinate in pixels
 * y is y-coordinate in pixels
 * deg is angle of rotation in degree
*/
void tftPrintDouble(double value,int x, int y, int deg)
{
	char buffer[100];
	sprintf(buffer,"%lf",value);
	tftPrint(buffer,x,y,deg);
}


/* output of String on display
 * if text is bigger than one page automatic page change after 2s is created
 * *st is String (char Array) to print
 * x is x-coordinate in pixels
 * y is y-coordinate in pixels
 * deg is angle of rotation in degree
*/
void tftPrint(char *st, int x, int y, int deg)
{
	int stl, i;
	int lettercount = 0;
	int xvalue = x;
	int yvalue = y;


	stl = strlen(st);

	if (x==RIGHT)
	{
		x=(width+1)-(stl*cfont.x_size);
	}
	if (x==CENTER)
	{
		x=((height+1)-(stl*cfont.x_size))/2;
	}
	for (i=0;i<stl;i++) // write each character of string onto screen
	{
		lettercount++;

		// check wheter char shall be rotated
		if (deg==0)
		{
			tftPrintChar(*st++,xvalue, y);
			xvalue=x+(lettercount*(cfont.x_size)); // go to next letter position in x direction
		}
		else
		{
			tftRotateChar(*st++, x, y, i, deg);
		}
		if(lettercount>((tftGetWidth()/cfont.x_size)-1)) //check if max letters in one line is reached
		{
			xvalue=0; //if so set x to zero
			lettercount=0;
			yvalue=y+cfont.y_size;

			if(yvalue>(tftGetHeight()-cfont.y_size)) // check if max letters on screen is reached
			{
				delayms(2000); // if so wait for 2s
				tftFillScreen(tft_BLACK); // clear screen
				y=0; // start at top left of new Page
			}
			else
			{
				y=yvalue; // else got to next line
			}

		}

	}
}
void tftPrintColor(char *st, int x, int y, uint16_t FontColor)
{
	uint16_t _fg_old = _fg;
	_fg = FontColor;
	tftPrint(st, x, y, 0);
	_fg = _fg_old;
}


/********************************************************************
*********************************************************************
*********************** Service functions ***************************
*********************************************************************
*********************************************************************/


// Function that fills screen with one color
void tftFillScreen(uint16_t color)
{
	tftFillRect(0, 0,width,height, color);
}


// Pass 8-bit (each) R,G,B, get back 16-bit packed color
uint16_t tftColor565(uint8_t r, uint8_t g, uint8_t b)
{
	return ((r & 0xF8) << 8) | ((g & 0xFC) << 3) | (b >> 3);
}


/* Function to set Rotation of Display
 * POTRAIT: x_max=128px y_max=160px
 * LANDSCAPE: x_max=160px y_max=128px
 * choose Between: PORTRAIT; POTRAIT_FLIP; LANDSCAPE; LANDSCAPE_FLIP
 */
void tftSetRotation(uint8_t m)
{
	uint8_t rotation = m % 4; // can't be higher than 3
	tftSendCmd(ST7735_MADCTL);

	switch (rotation)
	{
		case PORTRAIT:
		{
		tftSendData(MADCTL_MX | MADCTL_MY | MADCTL_RGB);
		width  = ST7735_TFTWIDTH;
		height = ST7735_TFTHEIGHT;
		break;
		}
	   case LANDSCAPE:
	   {
		   tftSendData(MADCTL_MY | MADCTL_MV | MADCTL_RGB);
		   width  = ST7735_TFTHEIGHT;
		   height = ST7735_TFTWIDTH;
		   break;
	   }
	   case PORTRAIT_FLIP:
	   {
		   tftSendData(MADCTL_RGB);
		   width  = ST7735_TFTWIDTH;
		   height = ST7735_TFTHEIGHT;
		   break;
	   }
	   case LANDSCAPE_FLIP:
	   {
		   tftSendData(MADCTL_MX | MADCTL_MV | MADCTL_RGB);
		   width  = ST7735_TFTHEIGHT;
		   height = ST7735_TFTWIDTH;
		   break;
	   }
	   default:
	   {
		   return;
	   }
	}

	orientation = m;
}


// function that inverts DisplayColors
void tftInvertDisplay(const uint8_t mode)
{
	if( mode == INVERT_ON )
	{
		tftSendCmd(ST7735_INVON);

	}
	else if( mode == INVERT_OFF )
	{
		tftSendCmd(ST7735_INVOFF);
	}
}


// tft off currently means only background light activated
void tftOff()
{
	tftSendCmd(ST7735_DISPOFF);
}


// turn on display
void tftOn()
{
	tftSendCmd(ST7735_DISPON);
}


uint8_t tftGetWidth()
{
	return(width); // width depends on Rotation Mode
}


uint8_t tftGetHeight()
{
	return(height); // height depends on Rotation Mode
}
